## components/espod/Kconfig
```kconfig
menu "esPod Logging"

    choice ESPOD_LOG_LEVEL_SELECTION
        prompt "esPod Log Level"
        default ESPOD_LOG_LEVEL_INFO
        help
            Select the runtime log level for the esPod state machine and Lingo handlers.

        config ESPOD_LOG_LEVEL_NONE
            bool "None"
        config ESPOD_LOG_LEVEL_ERROR
            bool "Error"
        config ESPOD_LOG_LEVEL_WARN
            bool "Warn"
        config ESPOD_LOG_LEVEL_INFO
            bool "Info"
        config ESPOD_LOG_LEVEL_DEBUG
            bool "Debug"
        config ESPOD_LOG_LEVEL_VERBOSE
            bool "Verbose"
    endchoice

    config ESPOD_LOG_LEVEL
        int
        default 0 if ESPOD_LOG_LEVEL_NONE
        default 1 if ESPOD_LOG_LEVEL_ERROR
        default 2 if ESPOD_LOG_LEVEL_WARN
        default 3 if ESPOD_LOG_LEVEL_INFO
        default 4 if ESPOD_LOG_LEVEL_DEBUG
        default 5 if ESPOD_LOG_LEVEL_VERBOSE
        default 3

endmenu
```

## components/pl2303_usb/Kconfig
```kconfig
menu "PL2303 USB Logging"

    choice PL2303_USB_LOG_LEVEL_SELECTION
        prompt "PL2303 USB Log Level"
        default PL2303_USB_LOG_LEVEL_INFO
        help
            Select the runtime log level for the PL2303 USB transceiver driver.

        config PL2303_USB_LOG_LEVEL_NONE
            bool "None"
        config PL2303_USB_LOG_LEVEL_ERROR
            bool "Error"
        config PL2303_USB_LOG_LEVEL_WARN
            bool "Warn"
        config PL2303_USB_LOG_LEVEL_INFO
            bool "Info"
        config PL2303_USB_LOG_LEVEL_DEBUG
            bool "Debug"
        config PL2303_USB_LOG_LEVEL_VERBOSE
            bool "Verbose"
    endchoice

    config PL2303_USB_LOG_LEVEL
        int
        default 0 if PL2303_USB_LOG_LEVEL_NONE
        default 1 if PL2303_USB_LOG_LEVEL_ERROR
        default 2 if PL2303_USB_LOG_LEVEL_WARN
        default 3 if PL2303_USB_LOG_LEVEL_INFO
        default 4 if PL2303_USB_LOG_LEVEL_DEBUG
        default 5 if PL2303_USB_LOG_LEVEL_VERBOSE
        default 3

endmenu
```

## main/Kconfig.projbuild
```kconfig
menu "superPod Core Configuration"

    menu "FreeRTOS Core & Task Affinities (Option B Swapped)"
        config BT_CTRL_PIN_TO_CORE
            int "Core ID for Bluetooth Controller Task"
            default 0
            help
                Core assigned to low-level Bluetooth radio controller (0 = PRO_CPU, 1 = APP_CPU).

        config BT_BLUEDROID_PIN_TO_CORE
            int "Core ID for Bluedroid Host Stack"
            default 0
            help
                Core assigned to Bluedroid host stack and A2DP Sink (0 = PRO_CPU, 1 = APP_CPU).

        config TINYUSB_TASK_CORE
            int "Core ID for TinyUSB Device Stack Task"
            default 1
            help
                Core assigned to TinyUSB device task (0 = PRO_CPU, 1 = APP_CPU).

        config ESPOD_TASK_CORE
            int "Core ID for esPod Protocol Engine Tasks"
            default 1
            help
                Core assigned to esPod Lingo processing tasks (0 = PRO_CPU, 1 = APP_CPU).
    endmenu

    menu "Task Stack Sizes and Priorities"
        config AVRC_QUEUE_SIZE
            int "AVRCP Metadata Queue Depth"
            default 32
            help
                Maximum number of pending AVRCP metadata items stored in queue.

        config PROCESS_AVRC_TASK_STACK_SIZE
            int "AVRCP Processing Task Stack Size"
            default 4096
            help
                Stack size in bytes for the AVRCP metadata processing task.

        config PROCESS_AVRC_TASK_PRIORITY
            int "AVRCP Processing Task Priority"
            default 6
            help
                Priority level for the AVRCP metadata processing task.
    endmenu

    menu "I2S External DAC Configuration"
        config I2S_BCLK_PIN
            int "I2S Bit Clock (BCLK) GPIO Pin"
            default 27

        config I2S_WS_PIN
            int "I2S Word Select (WS/LRCK) GPIO Pin"
            default 25

        config I2S_DOUT_PIN
            int "I2S Data Out (DOUT/SD) GPIO Pin"
            default 26
    endmenu

    menu "Bluetooth A2DP Sink Configuration"
        config A2DP_SINK_NAME
            string "Bluetooth A2DP Sink Device Name"
            default "superPod-A2DP"
    endmenu

    menu "USB PL2303 Bridge Configuration"
        config EP_VENDOR_BULK_OUT
            hex "Bulk OUT vendor endpoint address"
            default 0x02

        config EP_VENDOR_BULK_IN
            hex "Bulk IN vendor endpoint address"
            default 0x83

        config EP_VENDOR_IRQ
            hex "Interrupt vendor endpoint address"
            default 0x81

        config DTR_PIN
            int "DTR pin to control resets (-1 for virtual mode)"
            default -1
            help
                GPIO pin for DTR signal. Set to -1 to disable physical pin allocation and operate in pure virtual mode.

        config RTS_PIN
            int "RTS pin to control resets (-1 for virtual mode)"
            default -1
            help
                GPIO pin for RTS signal. Set to -1 to disable physical pin allocation and operate in pure virtual mode.

        config PL2303_DEFAULT_BAUDRATE
            int "Default virtual baud rate"
            default 19200
            help
                Initial virtual baud rate reported to USB host prior to host SET_LINE requests.
    endmenu

    menu "superPod Logging Configuration"
        choice SUPERPOD_MAIN_LOG_LEVEL_SELECTION
            prompt "Main Orchestrator Log Level"
            default SUPERPOD_MAIN_LOG_LEVEL_INFO
            help
                Select the runtime log level for the superPod main orchestrator.

            config SUPERPOD_MAIN_LOG_LEVEL_NONE
                bool "None"
            config SUPERPOD_MAIN_LOG_LEVEL_ERROR
                bool "Error"
            config SUPERPOD_MAIN_LOG_LEVEL_WARN
                bool "Warn"
            config SUPERPOD_MAIN_LOG_LEVEL_INFO
                bool "Info"
            config SUPERPOD_MAIN_LOG_LEVEL_DEBUG
                bool "Debug"
            config SUPERPOD_MAIN_LOG_LEVEL_VERBOSE
                bool "Verbose"
        endchoice

        config SUPERPOD_MAIN_LOG_LEVEL
            int
            default 0 if SUPERPOD_MAIN_LOG_LEVEL_NONE
            default 1 if SUPERPOD_MAIN_LOG_LEVEL_ERROR
            default 2 if SUPERPOD_MAIN_LOG_LEVEL_WARN
            default 3 if SUPERPOD_MAIN_LOG_LEVEL_INFO
            default 4 if SUPERPOD_MAIN_LOG_LEVEL_DEBUG
            default 5 if SUPERPOD_MAIN_LOG_LEVEL_VERBOSE
            default 3
    endmenu

endmenu
```
