/**
 * @file main.cpp
 * @brief superPod Single-MCU Unified Firmware Orchestrator.
 * 
 * =================================================================================
 * Architecture & Design Documentation:
 * =================================================================================
 * superPod unifies USB PL2303 transceiver emulation, Apple iPod Accessory Protocol
 * (espod Lingo engine), and Bluetooth Classic A2DP Sink audio streaming into a single
 * application running on the ESP32-S31.
 * 
 * Option B Swapped Dual-Core Task Allocation:
 *   - Core 0 (PRO_CPU): Dedicated Audio & Bluetooth Subsystem:
 *       * Low-level BT Controller Radio Task (Priority 23)
 *       * Bluedroid Host Stack & A2DP Sink (Priority 20)
 *       * Audio Stream Decoding & I2S Output (Priority 18)
 *       * AVRCP Metadata Callback Task (Priority 6, CONFIG_PROCESS_AVRC_TASK_PRIORITY)
 *   - Core 1 (APP_CPU): Dedicated USB & iPod Protocol Subsystem:
 *       * TinyUSB Device Stack Task (Priority 15)
 *       * USB <-> espod In-Memory Software Bridge Task (Priority 10, CONFIG_USB_ESPOD_BRIDGE_TASK_PRIORITY)
 *       * espod Lingo Protocol Engine Tasks (Priority 2-5)
 * 
 * Inter-Subsystem Data Pipeline:
 *   1. USB -> espod: USB Bulk OUT packets are read from pl2303_usb and fed directly
 *      into espod.processRawBuffer() in RAM.
 *   2. espod -> USB: Packets generated by espod are sent via pl2303_usb_write_bytes().
 *   3. espod -> A2DP: Playback control commands (Play, Pause, Stop, Next, Prev) trigger
 *      playStatusHandler() which invokes a2dp_sink methods on Core 0.
 *   4. A2DP -> espod: AVRCP metadata notifications (Title, Artist, Album, Duration, Position)
 *      update espod state on Core 1 via thread-safe queue.
 * =================================================================================
 */

#include <stdio.h>
#include <stdint.h>
#include <stdbool.h>
#include <string.h>
#include "esp_log.h"
#include "esp_system.h"
#include "esp_timer.h"
#include "nvs_flash.h"
#include "freertos/FreeRTOS.h"
#include "freertos/task.h"
#include "freertos/queue.h"

#include "pl2303_usb.h"
#include "esPod.h"

// Native BLE Audio Sink component
#include "ble_audio_sink.h"

static const char *TAG = "SUPERPOD_MAIN";

#pragma region Global Objects and Declarations
esPod espod(1, -1, -1, 19200); // esPod in direct memory ingestion mode (no UART pins required)

struct mediaMetadata
{
    uint8_t id = 0;
    uint8_t *payload = nullptr;
};

QueueHandle_t mediaMetadataQueue = nullptr;
TaskHandle_t processMediaTaskHandle = nullptr;

void initializeBLEAudioSink();
esp_err_t initializeMediaTask();
void connectionStateChanged(ble_audio_conn_state_t state, void *ptr);
void audioStateChanged(ble_audio_playback_state_t state, void *ptr);
void media_play_pos_callback(uint32_t play_pos);
void media_metadata_callback(uint8_t id, const uint8_t *text);
void playStatusHandler(PB_COMMAND playCommand);
#pragma endregion

#pragma region USB to espod In-Memory Software Bridge Task

/**
 * @brief Outbound USB transmit handler callback for forwarding espod response frames to USB Bulk IN endpoint.
 * 
 * @param[in] data Pointer to raw iAP frame bytes.
 * @param[in] len Length of data in bytes.
 */
static void usb_tx_handler(const uint8_t *data, size_t len)
{
    pl2303_usb_write_bytes(data, (uint32_t)len);
}

/**
 * @brief FreeRTOS task bridging USB Bulk OUT data directly to espod raw ringbuffer using event notifications.
 * 
 * @param pvParameters Unused.
 */
static void usb_espod_bridge_task(void *pvParameters)
{
    uint8_t usb_rx_buf[512];

    // Register current task handle to receive TinyUSB Bulk OUT receive notifications
    pl2303_usb_set_rx_task_handle(xTaskGetCurrentTaskHandle());

    while (1)
    {
        // Wait for event notification from TinyUSB Bulk OUT callback (100ms safety timeout)
        ulTaskNotifyTake(pdTRUE, pdMS_TO_TICKS(100));

        // Drain all available raw bytes from TinyUSB Bulk OUT endpoint
        while (1)
        {
            uint32_t rx_bytes = pl2303_usb_read_bytes(usb_rx_buf, sizeof(usb_rx_buf));
            if (rx_bytes == 0)
            {
                break;
            }
            ESP_LOGD(TAG, "USB -> espod: %lu bytes", rx_bytes);
            espod.processRawBuffer(usb_rx_buf, rx_bytes);
        }
    }
}

#pragma endregion

#pragma region Media Metadata Queue Processing Task

/**
 * @brief Low-priority task processing media track metadata items from queue and updating esPod state.
 * 
 * @param pvParameters Unused.
 */
static void processMediaTask(void *pvParameters)
{
    mediaMetadata incMetadata;

    while (true)
    {
        // Block indefinitely until a media metadata item is received from the queue
        if (xQueueReceive(mediaMetadataQueue, &incMetadata, portMAX_DELAY) == pdTRUE)
        {
            if (incMetadata.payload != nullptr)
            {
                // Route metadata payload to appropriate esPod state update method
                switch (incMetadata.id)
                {
                case BLE_AUDIO_MD_ATTR_ALBUM:
                    espod.updateAlbumName((char *)incMetadata.payload);
                    break;
                case BLE_AUDIO_MD_ATTR_ARTIST:
                    espod.updateArtistName((char *)incMetadata.payload);
                    break;
                case BLE_AUDIO_MD_ATTR_TITLE:
                    espod.updateTrackTitle((char *)incMetadata.payload);
                    break;
                case BLE_AUDIO_MD_ATTR_PLAYING_TIME:
                    espod.updateTrackDuration((uint32_t)atoi((char *)incMetadata.payload));
                    break;
                }
                // Free dynamically allocated payload string after esPod state update
                free(incMetadata.payload);
                incMetadata.payload = nullptr;
            }
        }
    }
}

#pragma endregion

#pragma region Helper Function Definitions

/**
 * @brief Configures I2S DAC GPIO pins and initializes the Bluetooth LE Audio Sink subsystem.
 */
void initializeBLEAudioSink()
{
    ble_audio_sink_config_t config = {
        .device_name = CONFIG_BLE_AUDIO_SINK_NAME,
        .bclk_pin = CONFIG_I2S_BCLK_PIN,
        .ws_pin = CONFIG_I2S_WS_PIN,
        .dout_pin = CONFIG_I2S_DOUT_PIN,
    };

    ESP_ERROR_CHECK(ble_audio_sink_init(&config));
    ble_audio_sink_set_connection_state_callback(connectionStateChanged, nullptr);
    ble_audio_sink_set_audio_state_callback(audioStateChanged, nullptr);
    ble_audio_sink_set_metadata_callback(media_metadata_callback);
    ble_audio_sink_set_play_pos_callback(media_play_pos_callback);

    ESP_ERROR_CHECK(ble_audio_sink_start());
    ESP_LOGI(TAG, "BLE Audio Sink started: %s", CONFIG_BLE_AUDIO_SINK_NAME);
}

/**
 * @brief Initializes media metadata queue and processing task on Core 0.
 * 
 * @return esp_err_t ESP_OK on success, or ESP_FAIL if queue/task creation fails.
 */
esp_err_t initializeMediaTask()
{
    // Create FreeRTOS queue for buffering incoming media metadata items
    mediaMetadataQueue = xQueueCreate(CONFIG_BLE_MEDIA_QUEUE_SIZE, sizeof(mediaMetadata));
    if (mediaMetadataQueue == nullptr)
    {
        ESP_LOGE(TAG, "Failed to create media metadata queue");
        return ESP_FAIL;
    }

    // Launch low-priority media processing task on Core 0 (PRO_CPU)
    xTaskCreatePinnedToCore(processMediaTask, "processMediaTask", CONFIG_PROCESS_MEDIA_TASK_STACK_SIZE, NULL,
                            CONFIG_PROCESS_MEDIA_TASK_PRIORITY, &processMediaTaskHandle, CONFIG_BT_BLUEDROID_PIN_TO_CORE);
    if (processMediaTaskHandle == nullptr)
    {
        ESP_LOGE(TAG, "Failed to create processMediaTask");
        return ESP_FAIL;
    }

    return ESP_OK;
}

#pragma endregion

#pragma region BLE Audio Callback Definitions

/**
 * @brief Handles Bluetooth LE Audio connection state changes.
 * 
 * Enables esPod protocol processing on peer connection, and disables/resets esPod state on disconnection.
 * 
 * @param[in] state Current BLE connection state.
 * @param[in] ptr Optional user data pointer (unused).
 */
void connectionStateChanged(ble_audio_conn_state_t state, void *ptr)
{
    switch (state)
    {
    case BLE_AUDIO_CONN_STATE_CONNECTED:
        ESP_LOGI(TAG, "BLE_AUDIO_CONN_STATE_CONNECTED, espod enabled");
        espod.disabled = false;
        ble_audio_sink_play();
        break;
    case BLE_AUDIO_CONN_STATE_DISCONNECTED:
        ESP_LOGI(TAG, "BLE_AUDIO_CONN_STATE_DISCONNECTED, espod disabled");
        espod.resetState();
        espod.disabled = true;
        break;
    default:
        break;
    }
}

/**
 * @brief Handles Bluetooth LE Audio playback state changes (Playing / Paused / Stopped).
 * 
 * Synchronizes esPod playback status state machine with Bluetooth audio stream state.
 * 
 * @param[in] state Current playback state.
 * @param[in] ptr Optional user data pointer (unused).
 */
void audioStateChanged(ble_audio_playback_state_t state, void *ptr)
{
    switch (state)
    {
    case BLE_AUDIO_PLAYBACK_PLAYING:
        espod.play(true);
        break;
    case BLE_AUDIO_PLAYBACK_PAUSED:
    case BLE_AUDIO_PLAYBACK_STOPPED:
        espod.pause(true);
        break;
    default:
        break;
    }
}

/**
 * @brief Handles periodic play position updates from Bluetooth peer.
 * 
 * @param[in] play_pos Current playback position in milliseconds.
 */
void media_play_pos_callback(uint32_t play_pos)
{
    espod.updatePlayPosition(play_pos);
    ESP_LOGV(TAG, "Play position: %lu ms", (unsigned long)play_pos);
}

/**
 * @brief Handles incoming track metadata attributes from Bluetooth peer.
 * 
 * Allocates a copy of the metadata text string and dispatches it to the processing queue.
 * 
 * @param[in] id Metadata attribute ID (Title, Artist, Album, Duration).
 * @param[in] text Pointer to null-terminated metadata text string.
 */
void media_metadata_callback(uint8_t id, const uint8_t *text)
{
    if (text == NULL) return;
    if ((id != BLE_AUDIO_MD_ATTR_PLAYING_TIME) && (text[0] == '\0')) return;

    // Allocate copy of metadata text payload for queue transfer
    mediaMetadata incMetadata;
    incMetadata.id = id;
    incMetadata.payload = (uint8_t *)strdup((const char *)text);

    if (incMetadata.payload == nullptr) return;

    // Push item to media metadata processing queue; free memory if queue is full
    if (xQueueSend(mediaMetadataQueue, &incMetadata, 0) != pdTRUE)
    {
        free(incMetadata.payload);
    }
}

/**
 * @brief Callback handler invoked by esPod when host sends iAP playback control commands.
 * 
 * Maps iAP playback commands (Play, Pause, Stop, Next, Prev) directly to BLE Audio sink methods.
 * 
 * @param[in] playCommand Target playback command enum value.
 */
void playStatusHandler(PB_COMMAND playCommand)
{
    switch (playCommand)
    {
    case PB_CMD_STOP:
        ble_audio_sink_stop();
        ESP_LOGD(TAG, "BLE_AUDIO_STOP");
        break;
    case PB_CMD_PLAY:
        ble_audio_sink_play();
        ESP_LOGD(TAG, "BLE_AUDIO_PLAY");
        break;
    case PB_CMD_PAUSE:
        ble_audio_sink_pause();
        ESP_LOGD(TAG, "BLE_AUDIO_PAUSE");
        break;
    case PB_CMD_PREVIOUS_TRACK:
    case PB_CMD_PREV:
        ble_audio_sink_previous();
        ESP_LOGD(TAG, "BLE_AUDIO_PREV");
        break;
    case PB_CMD_NEXT_TRACK:
    case PB_CMD_NEXT:
        ble_audio_sink_next();
        ESP_LOGD(TAG, "BLE_AUDIO_NEXT");
        break;
    default:
        break;
    }
}

#pragma endregion

#pragma region Main Entry Point

/**
 * @brief Main application entry point for superPod firmware.
 * 
 * Orchestrates dual-core initialization (Option B Swapped):
 *   - Core 1: TinyUSB PL2303 driver, esPod handlers, and direct in-memory software bridge task.
 *   - Core 0: Media metadata task and Bluetooth LE Audio Sink subsystem.
 */
extern "C" void app_main(void)
{
    // Step 0: Centrally configure subsystem log verbosity
    esp_log_level_set("PL2303_USB", ESP_LOG_DEBUG);
    esp_log_level_set("esPod", ESP_LOG_DEBUG);
    esp_log_level_set("BLE_AUDIO_SINK", ESP_LOG_DEBUG);
    esp_log_level_set(TAG, ESP_LOG_DEBUG);

    ESP_LOGI(TAG, "superPod firmware starting up on ESP32-S31...");
    ESP_LOGI(TAG, "Reset reason: %d", esp_reset_reason());

    // Step 0.5: Initialize NVS Flash (required for RF/PHY calibration and Bluetooth bonding)
    esp_err_t nvs_ret = nvs_flash_init();
    if (nvs_ret == ESP_ERR_NVS_NO_FREE_PAGES || nvs_ret == ESP_ERR_NVS_NEW_VERSION_FOUND) {
        ESP_ERROR_CHECK(nvs_flash_erase());
        nvs_ret = nvs_flash_init();
    }
    ESP_ERROR_CHECK(nvs_ret);
    ESP_LOGI(TAG, "NVS flash initialized successfully");

    // Step 1: Initialize TinyUSB PL2303 Device Driver on Core 1 (APP_CPU)
    ESP_ERROR_CHECK(pl2303_usb_init(CONFIG_TINYUSB_TASK_CORE));

    // Register line coding callback to observe host UART parameter setup
    pl2303_usb_set_line_coding_callback([](const pl2303_line_coding_t *coding) {
        ESP_LOGI(TAG, "Host applied line coding: %lu baud, %u stop, %u parity, %u bits",
                 (unsigned long)coding->baud_rate, coding->stop_bits, coding->parity, coding->data_bits);
    });

    // Step 2: Attach playback controller and outbound USB TX callbacks to espod
    espod.attachPlayControlHandler(playStatusHandler);
    espod.attachTxHandler(usb_tx_handler);
    espod.resetState();
    espod.disabled = true;

    // Step 3: Start USB <-> espod bridge task on Core 1 (APP_CPU)
    xTaskCreatePinnedToCore(usb_espod_bridge_task, "usb_espod_bridge", CONFIG_USB_ESPOD_BRIDGE_TASK_STACK_SIZE,
                            NULL, CONFIG_USB_ESPOD_BRIDGE_TASK_PRIORITY, NULL, CONFIG_TINYUSB_TASK_CORE);

    // Step 4: Initialize Media metadata task on Core 0 (PRO_CPU)
    if (initializeMediaTask() != ESP_OK)
    {
        ESP_LOGE(TAG, "Media Task init failed");
        esp_restart();
    }

    // Step 5: Start BLE Audio Sink subsystem
    initializeBLEAudioSink();

    ESP_LOGI(TAG, "superPod initialization completed. Waiting for Bluetooth peer connection...");
}

#pragma endregion

